## Documentation/devicetree/bindings/remoteproc/ingenic,vpu.yaml
```yaml
# SPDX-License-Identifier: (GPL-2.0 OR BSD-2-Clause)
%YAML 1.2
---
$id: "http://devicetree.org/schemas/remoteproc/ingenic,vpu.yaml#"
$schema: "http://devicetree.org/meta-schemas/core.yaml#"

title: Ingenic Video Processing Unit bindings

description:
  Inside the Video Processing Unit (VPU) of the recent JZ47xx SoCs from
  Ingenic is a second Xburst MIPS CPU very similar to the main core.
  This document describes the devicetree bindings for this auxiliary
  processor.

maintainers:
  - Paul Cercueil <paul@crapouillou.net>

properties:
  compatible:
    enum:
      - ingenic,jz4760-vpu-rproc
      - ingenic,jz4760b-vpu-rproc
      - ingenic,jz4770-vpu-rproc
      - ingenic,jz4775-vpu-rproc
      - ingenic,jz4780-vpu-rproc

  reg:
    oneOf:
      - items:
          - description: aux registers
          - description: tcsm0 registers
          - description: tcsm1 registers
          - description: sram registers
      - items:
          - description: aux registers
          - description: tcsm registers
          - description: sram registers

  reg-names:
    oneOf:
      - items:
          - const: aux
          - const: tcsm0
          - const: tcsm1
          - const: sram
      - items:
          - const: aux
          - const: tcsm
          - const: sram

  clocks:
    oneOf:
      - items:
          - description: aux clock
          - description: vpu clock
      - items:
          - description: vpu clock

  clock-names:
    oneOf:
      - items:
          - const: aux
          - const: vpu
      - items:
          - const: vpu

  interrupts:
    maxItems: 1

required:
  - compatible
  - reg
  - reg-names
  - clocks
  - clock-names
  - interrupts

additionalProperties: false

examples:
  - |
    #include <dt-bindings/clock/ingenic,jz4770-cgu.h>

    video-decoder@132a0000 {
      compatible = "ingenic,jz4770-vpu-rproc";

      reg = <0x132a0000 0x20>, /* AUX */
            <0x132b0000 0x4000>, /* TCSM0 */
            <0x132c0000 0xc000>, /* TCSM1 */
            <0x132f0000 0x7000>; /* SRAM */
      reg-names = "aux", "tcsm0", "tcsm1", "sram";

      clocks = <&cgu JZ4770_CLK_AUX>, <&cgu JZ4770_CLK_VPU>;
      clock-names = "aux", "vpu";

      interrupt-parent = <&cpuintc>;
      interrupts = <3>;
    };
  - |
    #include <dt-bindings/clock/jz4780-cgu.h>

    video-decoder@132a0000 {
      compatible = "ingenic,jz4780-vpu-rproc";

      reg = <0x132a0000 0x20>, /* AUX */
            <0x132c0000 0x8000>, /* TCSM */
            <0x132f0000 0x4000>; /* SRAM */
      reg-names = "aux", "tcsm", "sram";

      clocks = <&cgu JZ4780_CLK_VPU>;
      clock-names = "vpu";

      interrupt-parent = <&intc>;
      interrupts = <62>;
    };
```

## drivers/char/x1501_audio/Kconfig
```kconfig
# SPDX-License-Identifier: GPL-2.0-only


config X1501_LW_AUDIO
	tristate "Ingenic X1501 Lightweight Audio Interface"
	depends on MIPS || COMPILE_TEST
	depends on OF
	depends on COMMON_CLK
	help
	  Lightweight audio controller driver for the Ingenic X1501.

	  This driver implements the Open Sound System (OSS) API, but
	  does not require any special kernel components. It will work
	  in all subsequent versions of the Linux kernel unless Linus
	  decided to kill the character device APIs.

	  Since the X1501 only has an internal codec, it doesn't make
	  any sense to use the complex ALSA SoC audio APIs. By using
	  this driver, we can save as much as 300KiB of system RAM.

	  Although this is designed for the X1501, you can use it on
	  other 1st gen X series SoCs, such as the X1000.

	  RAM isn't cheap!

	  If unsure, say N.

choice
	depends on X1501_LW_AUDIO
	prompt "Choose implementation"
	default X1501_LW_AUDIO_YUKINO
	help
	  Since the two authors of this driver both can't agree with the design
	  principles of each other's implementation, this option allows the user
	  to choose between them.

config X1501_LW_AUDIO_YUKINO
	bool "Yukino's implementation"
	help
	  The implementation uses a linked list to manage the audio periods.

config X1501_LW_AUDIO_REIMU
	bool "Reimu's implementation"
	help
	  The implementation uses an index and per-period length information
	  to manage the audio periods.

endchoice
```

## drivers/gpu/drm/ingenic/Kconfig
```kconfig
config DRM_INGENIC
	tristate "DRM Support for Ingenic SoCs"
	depends on MIPS || COMPILE_TEST
	depends on DRM
	depends on CMA
	depends on OF
	depends on COMMON_CLK
	select VT_HW_CONSOLE_BINDING if FRAMEBUFFER_CONSOLE
	help
	  Choose this option for DRM support for the Ingenic SoCs.

	  If M is selected the module will be called ingenic-drm.

if DRM_INGENIC

config DRM_INGENIC_JZ_LCDC
	tristate "DRM Support for Ingenic JZ series LCD controller"
	select DRM_BRIDGE
	select DRM_PANEL_BRIDGE
	select DRM_KMS_HELPER
	select DRM_GEM_DMA_HELPER
	help
	  Choose this option for DRM support for the LCD controller of Ingenic JZ series SoCs.

	  If M is selected the module will be called ingenic-drm.

config DRM_INGENIC_X1000_SLCDC
	tristate "DRM Support for Ingenic X1000 series SLCD controller"
	select DRM_KMS_HELPER
	select DRM_GEM_DMA_HELPER
	help
	  Choose this option for DRM support for the SLCD controller of Ingenic X1000 series SoCs.

	  If M is selected the module will be called ingenic-slcd-drm.

if DRM_INGENIC_X1000_SLCDC

config DRM_INGENIC_X1000_SLCDC_DEBUG
	bool "Enable debugging"
	depends on DRM_INGENIC_X1000_SLCDC
	help
	  Choose this option to see all panel PIO operations in kernel log.

endif

config DRM_INGENIC_IPU
	bool "IPU support for Ingenic SoCs"
	help
	  Choose this option to enable support for the IPU found in Ingenic SoCs.

	  The Image Processing Unit (IPU) will appear as a second primary plane.

config DRM_INGENIC_DW_HDMI
	tristate "Ingenic specific support for Synopsys DW HDMI"
	depends on MACH_JZ4780
	select DRM_DW_HDMI
	help
	  Choose this option to enable Synopsys DesignWare HDMI based driver.
	  If you want to enable HDMI on Ingenic JZ4780 based SoC, you should
	  select this option.

endif
```

## drivers/media/platform/ingenic/Kconfig
```kconfig
# SPDX-License-Identifier: GPL-2.0-only

comment "Ingenic media platform drivers"

source "drivers/media/platform/ingenic/cim-x1000/Kconfig"
source "drivers/media/platform/ingenic/jpeg-x1000/Kconfig"
```

## drivers/media/platform/ingenic/cim-x1000/Kconfig
```kconfig
config VIDEO_INGENIC_CIM_X1000
	tristate "Ingenic X1000 series Camera Interface Module (CIM) driver"
	depends on VIDEO_DEV && (MACH_INGENIC || COMPILE_TEST)
	select VIDEO_V4L2_SUBDEV_API
	select VIDEOBUF2_DMA_CONTIG
	select MEDIA_CONTROLLER
	select V4L2_FWNODE
	help
		CIM Driver for X1000

config VIDEO_INGENIC_CIM_X1000_DEBUG
	tristate "Enable debugging output"
	depends on VIDEO_INGENIC_CIM_X1000
	help
		This enables dumping registers on various operations.
		FPS is also measured on every 60 frames.
		Your syslog will be spammed.
```

## drivers/media/platform/ingenic/jpeg-x1000/Kconfig
```kconfig
# SPDX-License-Identifier: GPL-2.0-only

config VIDEO_INGENIC_JPEG_X1000
	tristate "Ingenic X1000 series JPEG codec driver"
	depends on VIDEO_DEV && (MACH_INGENIC || COMPILE_TEST)
	select V4L2_MEM2MEM_DEV
	select VIDEOBUF2_DMA_CONTIG
```
